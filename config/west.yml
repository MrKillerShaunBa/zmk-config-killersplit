## config/west.yml
```yaml
manifest:
  remotes:
    - name: zmkfirmware
      url-base: https://github.com/zmkfirmware
    #- name: slideshow
     # url-base: https://github.com/MrKillerShaunBa
    - name: mctechnology17
      url-base: https://github.com/mctechnology17
  projects:
    - name: zmk
      remote: zmkfirmware
      revision: v0.3
      import: app/west.yml
    #- name: hammerbeam-slideshow
     # remote: slideshow
      #revision: main
    - name: zmk-nice-oled
      remote: mctechnology17
      revision: main
  self:
    path: config
```
